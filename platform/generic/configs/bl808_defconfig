## platform/generic/configs/bl808_defconfig
```kconfig
CONFIG_PLATFORM_BOUFFALOLAB_BL808=y
CONFIG_FDT_IPI=y
CONFIG_FDT_IPI_MSWI=y
CONFIG_FDT_IRQCHIP=y
CONFIG_FDT_IRQCHIP_PLIC=y
CONFIG_FDT_SERIAL=y
CONFIG_FDT_SERIAL_BL808=y
CONFIG_FDT_TIMER=y
CONFIG_FDT_TIMER_MTIMER=y
```
